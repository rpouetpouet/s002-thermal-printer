## firmware/s002-bridge/main/Kconfig.projbuild
```kconfig
menu "S002 bridge (v0)"

    config S002_WIFI_SSID
        string "Wi-Fi SSID"
        default ""
        help
            Réseau auquel le pont se rattache. Laisser vide = pas de Wi-Fi (mesure BLE seule).

    config S002_WIFI_PASSWORD
        string "Wi-Fi password"
        default ""

    config S002_PRINTER_MAC
        string "Adresse MAC de l'imprimante"
        default "06:03:DD:EC:16:4D"
        help
            Adresse vue le 28/09/2026. ATTENTION : c'est une adresse privee NON RESOLVABLE,
            donc susceptible d'etre regeneree par l'imprimante. La recherche se fait AUSSI par
            nom (voir S002_NOM), qui est le critere robuste.

    config S002_NOM
        string "Nom annonce par l'imprimante (critere principal)"
        default "S002"

    config S002_WRITE_HANDLE
        hex "Handle d'écriture (ff02, instance service000c)"
        default 0x11
        help
            Mesuré le 28/09 : l'imprimante expose ff02 DEUX fois ; seul le handle le plus
            haut écrit réellement. La découverte des services affiche le plan réel : le
            confronter à cette valeur avant d'imprimer.

    config S002_NOTIFY_STATE_HANDLE
        hex "Handle de notification d'état (ff01)"
        default 0xe

    config S002_NOTIFY_FLOW_HANDLE
        hex "Handle de notification de flux (ff03)"
        default 0x13

    config S002_LINES_PER_FRAME
        int "Lignes par trame d'image"
        range 1 40
        default 8
        help
            Mesuré : 40 lignes (2880 o) sont acceptées, 42 refusées. 8 lignes = 576 o.

    config S002_TEST_PATTERN_LINES
        int "Hauteur du motif de test, en lignes"
        range 8 200
        default 24

    config S002_TEST_RECETTE
        bool "Imprimer la recette embarquee (test LONG) au lieu du motif"
        default y
        help
            1099 lignes = 93 mm d'avance. C'est le VRAI test de continuite : le motif de 24
            lignes ne couvre que 2 mm de papier. Le raster est produit par tools/make_recipe.py
            via le rendu de l'integration HA (yk.text_raster), donc le papier du test est
            exactement ce que HA enverrait.

    config S002_ITVL_MIN
        int "Intervalle de connexion minimum (unites de 1,25 ms)"
        range 6 3200
        default 6
        help
            6 = 7,5 ms. Debit utile = 200 o par intervalle : a 15 ms on plafonne vers 15 Ko/s
            alors que l'imprimante consomme 17 Ko/s a 20 mm/s (blanc par assecchage du tampon).
            Forcer 6/6 vise 8-10 ms par ecriture, soit ~25 Ko/s.

    config S002_ITVL_MAX
        int "Intervalle de connexion maximum (unites de 1,25 ms)"
        range 6 3200
        default 12

    config S002_MODE_SERVEUR
        bool "Mode noeud reseau (serveur TCP), aucune impression automatique"
        default y
        help
            En mode serveur, le firmware ouvre un serveur TCP et attend les trames envoyees par
            un client (Home Assistant ou tools/s002_node_client.py). Rien n'est imprime au
            demarrage. Desactiver cette option pour revenir au banc de mesure, qui imprime le
            motif de test (ou la recette si S002_TEST_RECETTE est active) des le demarrage.

    config S002_PORT_TCP
        int "Port du serveur TCP"
        range 1024 65535
        default 3333
        help
            Port d'ecoute du noeud. C'est ce port qu'il faut renseigner cote Home Assistant
            (option "node_port") ou dans tools/s002_node_client.py.

    config S002_FLOW_AUTORISATION_INITIALE
        int "Paquets autorises avant le premier credit de l'imprimante"
        range 0 64
        default 8
        help
            L'imprimante annonce son premier credit (`01 07` = 7 paquets) apres l'abonnement.
            Ce garde-fou evite de rester bloque si cette notification se perd : on envoie
            quand meme ces quelques paquets avant d'exiger un credit.

endmenu
```
